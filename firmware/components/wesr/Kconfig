## firmware/components/wesr/Kconfig
```kconfig
menu "WESR-STOCK"

    config WESR_WIFI_SSID
        string "WiFi SSID (2.4G)"
        default ""
        help
            开发板要连的 2.4G 网络名。留空则开机直接显示「未配网」状态条，等 M4 的小程序 BLE 配网来填。

    config WESR_WIFI_PASSWORD
        string "WiFi password"
        default ""

    config WESR_DEBUG_FB_DUMP
        bool "开发期：每 15 秒把显存 dump 成 ASCII 到串口"
        default n
        help
            仅用于开发验证（没有相机/看不到屏幕时，回读显存自检画面）。
            量产固件请保持关闭：它会周期性占用串口约 10 秒。

    config WESR_FLUSH_FAST
        bool "刷屏快路径：整帧批量转换 + 帧差短路"
        default y
        help
            开启后 flush 用"每 4 行一个整字节"的顺序批量转换（不再逐像素查表 + 读改写），
            并在整帧内容与上一帧一致时跳过 SPI 发送。
            实测单帧转换 141ms → 数毫秒，且空刷帧几乎零成本。
            关掉则回退到老的逐像素 LUT 路径（保留了作对照/回退用）。

endmenu
```
